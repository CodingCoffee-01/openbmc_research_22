## meta-ast_bsp/conf/machine/ast_g5_bsp.conf
```bitbake
KERNEL_DEVICETREE = "aspeed-ast2500-evb.dtb"
#UBOOT_MACHINE = "ast_g5_phy_config"
#UBOOT_DEVICETREE = "ast2500-romulus"

UBOOT_MACHINE = "evb-ast2500_defconfig"
UBOOT_DEVICETREE = "ast2500-evb"

#require conf/machine/include/ast_bsp.inc
require conf/machine/include/ast2500.inc
require conf/machine/include/obmc-bsp-common.inc
require conf/machine/include/obmc-evb-common.inc
#require conf/machine/include/arm/armv6/tune-arm1176jz-s.inc

SERIAL_CONSOLES = "115200;ttyS4"

#PREFERRED_PROVIDER_virtual/kernel ?= "linux-aspeed"
#PREFERRED_PROVIDER_virtual/bootloader ?= "u-boot-aspeed"
#PREFERRED_PROVIDER_u-boot ?= "u-boot-aspeed"
#PREFERRED_PROVIDER_u-boot-fw-utils ?= "u-boot-fw-utils-aspeed"

#PREFERRED_PROVIDER_virtual/phosphor-led-manager-config-native = "dl360poc-led-manager-config-native"

#VIRTUAL-RUNTIME_obmc-fan-control ?= "phosphor-pid-control"
```

## meta-ast_bsp/conf/machine/include/ast_bsp.inc
```bitbake
KERNEL_DEVICETREE = "aspeed-ast2500-evb.dtb"
UBOOT_MACHINE = "ast_g5_phy_config"

require conf/machine/include/ast_bsp.inc
require conf/machine/include/obmc-bsp-common.inc
require conf/machine/include/obmc-evb-common.inc
require conf/machine/include/arm/armv6/tune-arm1176jz-s.inc

SERIAL_CONSOLES = "115200;ttyS4"

PREFERRED_PROVIDER_virtual/kernel ?= "linux-aspeed"
PREFERRED_PROVIDER_virtual/bootloader ?= "u-boot-aspeed"
PREFERRED_PROVIDER_u-boot ?= "u-boot-aspeed"
PREFERRED_PROVIDER_u-boot-fw-utils ?= "u-boot-fw-utils-aspeed"

#PREFERRED_PROVIDER_virtual/phosphor-led-manager-config-native = "dl360poc-led-manager-config-native"

#VIRTUAL-RUNTIME_obmc-fan-control ?= "phosphor-pid-control"
```

## meta-ast_bsp/meta-bsp_board2/conf/machine/ast_g6_bsp.conf
```bitbake
#KERNEL_DEVICETREE = "aspeed-ast2500-evb.dtb"
KERNEL_DEVICETREE = "aspeed-bmc-opp-tacoma.dtb"


#UBOOT_MACHINE = "ast_g5_phy_config"
#UBOOT_CONFIG = "evb-ast2500_defconfig"

#UBOOT_DEVICETREE = "ast2500-romulus"

UBOOT_MACHINE = "ast2600_openbmc_spl_defconfig"
UBOOT_DEVICETREE = "ast2600-tacoma"

# ASpeed SDK uboot
#UBOOT_MACHINE = "evb-ast2600-spl_defconfig"
#UBOOT_DEVICETREE = "ast2600-evb"


#require conf/machine/include/ast2500.inc
require conf/machine/include/ast2600.inc
require conf/machine/include/openpower.inc
require conf/machine/include/obmc-evb-common.inc
require conf/machine/include/obmc-bsp-common.inc

SERIAL_CONSOLES = "115200;ttyS4"

FLASH_SIZE = "131072"

SPL_BINARY = "spl/u-boot-spl.bin"
SOCSEC_SIGN_ENABLE = "0"


PREFERRED_PROVIDER_virtual/kernel ?= "linux-aspeed"
PREFERRED_PROVIDER_virtual/bootloader ?= "u-boot-aspeed"
PREFERRED_PROVIDER_u-boot ?= "u-boot-aspeed"
PREFERRED_PROVIDER_u-boot-fw-utils ?= "u-boot-fw-utils-aspeed"

#VIRTUAL-RUNTIME_obmc-inventory-manager = "entity-manager"
VIRTUAL-RUNTIME_obmc-sensors-hwmon = "phosphor-hwmon"

# Inhibit phosphor-hwmon-config-mrw
#VIRTUAL-RUNTIME_phosphor-hwmon-config:df-mrw = ""

#PREFERRED_PROVIDER_virtual/bootloader:aspeed-g6 ?= "u-boot-aspeed-sdk"
#PREFERRED_PROVIDER_u-boot:aspeed-g6 ?= "u-boot-aspeed-sdk"
#PREFERRED_PROVIDER_u-boot-fw-utils:aspeed-g6 ?= "u-boot-fw-utils-aspeed-sdk"

# Build a FIT image and stuff core-image-minimal in it by default.
#KERNEL_IMAGETYPE ?= "fitImage"
#KERNEL_CLASSES ?= "kernel-fitimage"
#INITRAMFS_IMAGE ?= "aspeed-image-initramfs"
#INITRAMFS_FSTYPES ?= "cpio.xz"

#require conf/machine/include/ast_bsp.inc
#require conf/machine/include/obmc-bsp-common.inc
#require conf/machine/include/obmc-evb-common.inc


#PREFERRED_PROVIDER_virtual/phosphor-led-manager-config-native = "dl360poc-led-manager-config-native"

#VIRTUAL-RUNTIME_obmc-fan-control ?= "phosphor-pid-control"
```

## meta-ast_bsp/meta-bsp_g5_2/conf/machine/bsp_g5_2.conf
```bitbake
KMACHINE = "aspeed"
#KERNEL_DEVICETREE = "${KMACHINE}-ast2500-evb.dtb"
#KERNEL_DEVICETREE = "${KMACHINE}-bmc-opp-romulus.dtb"
#KERNEL_DEVICETREE = "${KMACHINE}-bmc-amd-ethanolx.dtb"
KERNEL_DEVICETREE = "${KMACHINE}-bmc-asrock-e3c246d4i.dtb"

PREFERRED_PROVIDER_virtual/bootloader = "u-boot-aspeed"
PREFERRED_PROVIDER_u-boot = "u-boot-aspeed"
PREFERRED_PROVIDER_u-boot-fw-utils = "u-boot-fw-utils-aspeed"
UBOOT_MACHINE = "ast_g5_phy_defconfig"
UBOOT_DEVICETREE = "ast2500-evb"

require conf/machine/include/ast2500.inc
require conf/machine/include/obmc-bsp-common.inc

SERIAL_CONSOLES = "115200;ttyS4"

FLASH_SIZE = "32768"

MACHINE_FEATURES += "\
        obmc-bmc-state-mgmt \
        obmc-chassis-state-mgmt \
        obmc-host-state-mgmt \
        obmc-phosphor-chassis-mgmt \
        obmc-host-ipmi \
        obmc-phosphor-fan-mgmt \
	"
#        obmc-phosphor-flash-mgmt


PREFERRED_PROVIDER_virtual/obmc-flash-mgmt = "packagegroup-obmc-apps"
PREFERRED_PROVIDER_virtual/obmc-system-mgmt = "packagegroup-obmc-apps"

VIRTUAL-RUNTIME_obmc-host-state-manager = "x86-power-control"
VIRTUAL-RUNTIME_obmc-chassis-state-manager = "x86-power-control"

VIRTUAL-RUNTIME_obmc-inventory-manager = "entity-manager"
VIRTUAL-RUNTIME_obmc-sensors-hwmon = "dbus-sensors"
#VIRTUAL-RUNTIME_obmc-sensors-hwmon ?= "phosphor-hwmon"


PREFERRED_PROVIDER_virtual/obmc-flash-mgmt = "obmc-phosphor-flash-mgmt"
PREFERRED_PROVIDER_virtual/obmc-host-ipmi-hw ?= "phosphor-ipmi-kcs"


#PREFERRED_PROVIDER_virtual/obmc-chassis-mgmt = "packagegroup-amd-apps"
#PREFERRED_PROVIDER_virtual/obmc-fan-mgmt = "packagegroup-amd-apps"

#PREFERRED_PROVIDER_virtual/obmc-inventory-data ?= "${VIRTUAL-RUNTIME_skeleton_workbook}"
#PREFERRED_PROVIDER_virtual/obmc-system-mgmt = "packagegroup-amd-apps"
#PREFERRED_PROVIDER_virtual/phosphor-led-manager-config-native = "ethanolx-led-manager-config-native"

#OVERRIDES .= ":ast_bsp"
```

## meta-ast_bsp/meta-bsp_g6/conf/layer.conf
```bitbake
# We have a conf and classes directory, add to BBPATH
BBPATH .= ":${LAYERDIR}/"

BBFILES += "${LAYERDIR}/recipes-*/*/*.bb \
            ${LAYERDIR}/recipes-*/*/*.bbappend"

BBFILE_COLLECTIONS += "bsp_g5-layer"
BBFILE_PATTERN_bsp_g5-layer := "^${LAYERDIR}/"
LAYERSERIES_COMPAT_bsp_g5-layer = "langdale mickledore"
```

## meta-ast_bsp/meta-bsp_g6/conf/machine/bsp_g6.conf
```bitbake
KMACHINE = "aspeed"
#KERNEL_DEVICETREE = "${KMACHINE}-ast2500-evb.dtb"
#KERNEL_DEVICETREE = "${KMACHINE}-bmc-opp-romulus.dtb"
#KERNEL_DEVICETREE = "${KMACHINE}-bmc-amd-ethanolx.dtb"
KERNEL_DEVICETREE = "aspeed-bmc-opp-tacoma.dtb"

PREFERRED_PROVIDER_virtual/bootloader = "u-boot-aspeed-sdk"
PREFERRED_PROVIDER_u-boot = "u-boot-aspeed-sdk"
PREFERRED_PROVIDER_u-boot-fw-utils = "u-boot-fw-utils-aspeed-sdk"
#UBOOT_MACHINE = "ast_g5_phy_defconfig"
#UBOOT_DEVICETREE = "ast2500-evb"

UBOOT_MACHINE = "ast2600_openbmc_spl_defconfig"
UBOOT_DEVICETREE = "ast2600-tacoma"

require conf/machine/include/ast2600.inc
require conf/machine/include/obmc-bsp-common.inc

SERIAL_CONSOLES = "115200;ttyS4"

#FLASH_SIZE = "32768"

FLASH_SIZE = "131072"

SPL_BINARY = "spl/u-boot-spl.bin"
SOCSEC_SIGN_ENABLE = "0"


MACHINE_FEATURES += "\
        obmc-bmc-state-mgmt \
        obmc-chassis-state-mgmt \
        obmc-host-state-mgmt \
        obmc-phosphor-chassis-mgmt \
        obmc-host-ipmi \
        obmc-phosphor-fan-mgmt \
	"
#        obmc-phosphor-flash-mgmt
        

#VIRTUAL-RUNTIME_skeleton_workbook = "${MACHINE}-config"
#VIRTUAL-RUNTIME_obmc-host-state-manager ?= "x86-power-control"
#VIRTUAL-RUNTIME_obmc-chassis-state-manager ?= "x86-power-control"
VIRTUAL-RUNTIME_obmc-sensors-hwmon ?= "dbus-sensors"

#PREFERRED_PROVIDER_virtual/obmc-chassis-mgmt = "packagegroup-amd-apps"
#PREFERRED_PROVIDER_virtual/obmc-fan-mgmt = "packagegroup-amd-apps"
#PREFERRED_PROVIDER_virtual/obmc-flash-mgmt = "obmc-phosphor-flash-mgmt"
#PREFERRED_PROVIDER_virtual/obmc-host-ipmi-hw ?= "phosphor-ipmi-kcs"
#PREFERRED_PROVIDER_virtual/obmc-inventory-data ?= "${VIRTUAL-RUNTIME_skeleton_workbook}"
#PREFERRED_PROVIDER_virtual/obmc-system-mgmt = "packagegroup-amd-apps"
#PREFERRED_PROVIDER_virtual/phosphor-led-manager-config-native = "ethanolx-led-manager-config-native"

OVERRIDES .= ":ast_bsp"
```

## meta-ast_bsp/meta-bsp_g6_2/conf/layer.conf
```bitbake
# We have a conf and classes directory, add to BBPATH
BBPATH .= ":${LAYERDIR}/"

BBFILES += "${LAYERDIR}/recipes-*/*/*.bb \
            ${LAYERDIR}/recipes-*/*/*.bbappend"

BBFILE_COLLECTIONS += "bsp_g6-layer"
BBFILE_PATTERN_bsp_g6-layer := "^${LAYERDIR}/"
LAYERSERIES_COMPAT_bsp_g6-layer = "langdale mickledore"
```
